## build/conf/bblayers.conf
```bitbake
# POKY_BBLAYERS_CONF_VERSION is increased each time build/conf/bblayers.conf
# changes incompatibly
POKY_BBLAYERS_CONF_VERSION = "2"

BBPATH = "${TOPDIR}"
PRJDIR := "${@os.path.abspath(os.path.dirname(d.getVar('FILE', True)) + '/../..')}"
BBFILES ?= ""

BBLAYERS ?= " \
  ${PRJDIR}/sources/poky/meta \
  ${PRJDIR}/sources/poky/meta-poky \
  ${PRJDIR}/sources/poky/meta-yocto-bsp \
  \
  ${PRJDIR}/sources/meta-gdc \
  "
```
